## components/board/Kconfig
```kconfig
menu "Deskstrate board"

    choice DESKSTRATE_BOARD
        prompt "Target board"
        default DESKSTRATE_BOARD_FEATHER_S3_TFT
        help
            Selects the pin map in board_config.h. PlatformIO keeps a separate
            sdkconfig.<env> per environment, so each board env keeps its own choice.

        config DESKSTRATE_BOARD_FEATHER_S3_TFT
            bool "Adafruit Feather ESP32-S3 TFT (desk unit / bench stand-in)"

        config DESKSTRATE_BOARD_S3_MINI
            bool "diymore ESP32-S3 Mini (central box)"
    endchoice

endmenu
```

## components/web_tls/Kconfig
```kconfig
menu "Deskstrate HTTPS"

    config DESKSTRATE_TLS_DOMAIN
        string "Domain the boards' certificate covers (as *.<domain>)"
        default "deskstrate.nogsnet.com"
        help
            Each board's CSR asks for *.<domain>, so the board is reachable as
            <anything>.<domain> once a DNS record points that name at it (e.g.
            core.deskstrate.nogsnet.com). Changing it needs new CSRs in the repo
            (tls/<name>.csr, from GET /api/tls/csr); the key stays the same.

endmenu
```

## components/wifi_sta/Kconfig
```kconfig
menu "Deskstrate Wi-Fi"

    config DESKSTRATE_WIFI_SSID
        string "Wi-Fi SSID"
        default ""
        help
            SSID of the 2.4 GHz Wi-Fi network to join. Stored in NVS on first boot;
            leave blank to keep using the stored network (CI and OTA builds do).

    config DESKSTRATE_WIFI_PASSWORD
        string "Wi-Fi password"
        default ""
        help
            Password for the Wi-Fi network. Leave blank for an open network.

endmenu
```

## firmware/core/src/Kconfig.projbuild
```kconfig
menu "Deskstrate core"

    config DESKSTRATE_DDC_TOGGLE_TEST
        bool "Toggle-test DDC1 lines at boot"
        default n
        help
            Before starting I2C, drives SDA then SCL low/high for 3 s each (2 cycles)
            so you can follow them with a meter on HDMI pins 16/15.

    config DESKSTRATE_SWD_BRINGUP
        bool "Log hub SWD state at boot"
        default n
        help
            Connects to both USB hubs over SWD and logs each one's SW-DP IDCODE and
            selection state once at boot. Read-only: it never writes the request byte.
            Use it to confirm SWD wiring and the per-build status-word address before
            trusting switching.

    config DESKSTRATE_OTA_TOKEN
        string "OTA upload token"
        default ""
        help
            Bearer token that POST /api/ota requires (Authorization: Bearer <token>),
            at least 16 characters. Stored in NVS on boot; leave blank to keep using
            the stored one (CI and OTA builds do). With no token stored at all, OTA
            uploads are refused.

endmenu
```

## firmware/kb/src/Kconfig.projbuild
```kconfig
menu "Deskstrate keyboard"

    choice DESKSTRATE_KB_LED_KIND
        prompt "Status LED kind"
        default DESKSTRATE_KB_LED_SINGLE_LOW
        help
            The keyboard's board is a Seeed XIAO ESP32S3 Plus: one yellow user LED,
            lit while GPIO21 is low. S3 Mini boards have a WS2812 (RGB) instead.

        config DESKSTRATE_KB_LED_SINGLE_LOW
            bool "Single LED, lit when low (XIAO ESP32S3)"
        config DESKSTRATE_KB_LED_WS2812
            bool "WS2812 (S3 Mini: GPIO21 on an S3-Zero, GPIO48 on a Super Mini)"
    endchoice

    config DESKSTRATE_KB_LED_GPIO
        int "Status LED GPIO, -1 for none"
        range -1 48
        default 21
        help
            GPIO21 on the XIAO ESP32S3 (and the WS2812 of an S3-Zero layout board);
            GPIO48 for the WS2812 of an S3 Super Mini.

    config DESKSTRATE_KB_RX_GPIO
        int "UART RX GPIO (from the keyboard's PB12)"
        range 0 21
        default 1
        help
            Must be an RTC GPIO (0-21): it also wakes the board from deep sleep.
            The keyboard holds this line high (UART idle) while it has USB power
            and low without it.

    config DESKSTRATE_KB_TX_GPIO
        int "UART TX GPIO (to the keyboard's PA3, USART2 RX)"
        range 0 48
        default 2


    config DESKSTRATE_KB_SLEEP
        bool "Deep sleep while the keyboard has no USB power"
        default y
        help
            Sleeps once the RX line has been low for DESKSTRATE_KB_SLEEP_HOLDOFF_S
            and wakes when it goes high again. Turn off for bench work without
            the keyboard attached.

    config DESKSTRATE_KB_SLEEP_HOLDOFF_S
        int "Seconds the RX line must stay low before sleeping"
        depends on DESKSTRATE_KB_SLEEP
        default 30

endmenu
```
