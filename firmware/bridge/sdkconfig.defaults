## firmware/bridge/src/Kconfig.projbuild
```kconfig
menu "Deskstrate bridge"

    config DESKSTRATE_BRIDGE_LED_GPIO
        int "Status LED (WS2812) GPIO, -1 for none"
        range -1 48
        default 48
        help
            GPIO48 on an S3 Super Mini (HW-747); GPIO21 on an S3 Mini or S3-Zero.

endmenu
```
